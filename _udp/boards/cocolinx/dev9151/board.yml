## _udp/boards/cocolinx/dev9151/board.yml
```yaml
board:
  name: cocolinx_dev9151
  full_name: nRF9160 dev9151
  vendor: cocolinx
  socs:
  - name: nrf9151
    variants:
    - name: 'ns'
```

## battery/boards/cocolinx/dev9151/Kconfig.cocolinx_dev9151
```kconfig
# Copyright (c) 2023 cocolinx
# Copyright (c) 2018-2020 Nordic Semiconductor ASA
# SPDX-License-Identifier: Apache-2.0

config BOARD_COCOLINX_DEV9151
	select SOC_NRF9151_LACA
```
