## CMakeLists.txt
```
cmake_minimum_required(VERSION 3.20.0)
find_package(Zephyr REQUIRED HINTS $ENV{ZEPHYR_BASE})

project(button)

target_sources(app PRIVATE src/main.c)
```

## prj.conf
```kconfig
CONFIG_FPU=y

# Stacks and heaps
CONFIG_MAIN_STACK_SIZE=4096
CONFIG_HEAP_MEM_POOL_SIZE=4096

# Log
CONFIG_LOG=y
CONFIG_LOG_DEFAULT_LEVEL=3
CONFIG_LOG_BUFFER_SIZE=2048
CONFIG_LOG_BACKEND_RTT=n
CONFIG_LOG_BACKEND_UART=y
CONFIG_LOG_BACKEND_UART_BUFFER_SIZE=2048

# Use GPIO
CONFIG_GPIO=y
CONFIG_GPIO_NRFX=y

# FLASH # NVS
CONFIG_FLASH=y
CONFIG_FLASH_MAP=y
CONFIG_FLASH_PAGE_LAYOUT=y
CONFIG_MPU_ALLOW_FLASH_WRITE=y
CONFIG_NVS=y
```

## src/main.c
```c
#include <zephyr/kernel.h>
#include <zephyr/logging/log.h>
#include <modem/nrf_modem_lib.h>
#include <zephyr/drivers/gpio.h>

/* onboard button pin num */
#define PIN_BUTTON_0 18
/* prevent chattering */
#define DEBOUNCE_MS 20

LOG_MODULE_REGISTER(main_button, CONFIG_LOG_DEFAULT_LEVEL);
static const struct gpio_dt_spec btn = GPIO_DT_SPEC_GET(DT_ALIAS(button0), gpios);

static void btn_debounce_work_handler(struct k_work *work);
K_WORK_DELAYABLE_DEFINE(btn_debounce_work, btn_debounce_work_handler);
static struct gpio_callback btn_cb;

static void btn_isr(const struct device *port, struct gpio_callback *cb, uint32_t pins)
{
    (void)k_work_reschedule(&btn_debounce_work, K_MSEC(DEBOUNCE_MS));
}

static void btn_debounce_work_handler(struct k_work *work)
{
    int ret = gpio_pin_get_dt(&btn); 
    if(ret < 0) {
        LOG_ERR("Failed to get gpio pin status %d", ret);
        return;
    }
    if(ret) LOG_INF("button pressed");
    else LOG_INF("button released");
}

int main(void)
{
    int err;
    err = nrf_modem_lib_init();
    if(err < 0)
        LOG_ERR("Unable to initialize modem lib. (err: %d)", err);
    
    LOG_INF("=====BUTTON EXAMPLE=====");
    
    err = gpio_pin_configure_dt(&btn, GPIO_INPUT | GPIO_PULL_UP);
    if(err < 0) {
        LOG_ERR("Failed to config gpio pin %d", err);
        return 0;
    }
    err = gpio_pin_interrupt_configure_dt(&btn, GPIO_INT_DISABLE);
    if(err < 0) {
        LOG_ERR("Failed to config gpio pin interrupt %d", err);
        return 0;
    }

    gpio_init_callback(&btn_cb, btn_isr, BIT(PIN_BUTTON_0));
    err = gpio_add_callback_dt(&btn, &btn_cb);
    if(err < 0) {
        LOG_ERR("Failed to add gpio callback %d", err);
        return 0;
    }
    err = gpio_pin_interrupt_configure_dt(&btn, GPIO_INT_EDGE_BOTH); /* rising | falling */
    if(err < 0) {
        LOG_ERR("Failed to config gpio pin interrupt %d", err);
        return 0;
    }

    LOG_INF("press button to test!");

    return 0;
}
```
