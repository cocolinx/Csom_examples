## CMakeLists.txt
```
cmake_minimum_required(VERSION 3.20.0)
find_package(Zephyr REQUIRED HINTS $ENV{ZEPHYR_BASE})

project(blinky)

target_sources(app PRIVATE src/main.c)
```

## prj.conf
```kconfig
CONFIG_FPU=y

# Stacks and heaps
CONFIG_MAIN_STACK_SIZE=4096
CONFIG_HEAP_MEM_POOL_SIZE=4096

# Log
CONFIG_LOG=y
CONFIG_LOG_DEFAULT_LEVEL=3
CONFIG_LOG_BUFFER_SIZE=2048
CONFIG_LOG_BACKEND_RTT=n
CONFIG_LOG_BACKEND_UART=y
CONFIG_LOG_BACKEND_UART_BUFFER_SIZE=2048

# Use GPIO
CONFIG_GPIO=y
CONFIG_GPIO_NRFX=y

# Modem library
CONFIG_NRF_MODEM_LIB=y
CONFIG_NRF_MODEM_LIB_TRACE=n
CONFIG_ZVFS_OPEN_MAX=8
```

## src/main.c
```c
#include <zephyr/kernel.h>
#include <zephyr/logging/log.h>
#include <modem/nrf_modem_lib.h>
#include <zephyr/drivers/gpio.h>

LOG_MODULE_REGISTER(main, CONFIG_LOG_DEFAULT_LEVEL);

static const struct gpio_dt_spec led0 = GPIO_DT_SPEC_GET(DT_ALIAS(led0), gpios);

int main(void)
{
    int err;
    err = nrf_modem_lib_init();
    if(err < 0) LOG_ERR("Unable to initialize modem lib. (err: %d)", err);
    
    LOG_INF("=====BLINKY EXAMPLE=====");

    if (!device_is_ready(led0.port)) 
    {
        LOG_ERR("LED device not ready");
        return 0;
    }
    err = gpio_pin_configure_dt(&led0, GPIO_OUTPUT_INACTIVE);
    if(err < 0) 
    {
        LOG_ERR("Failed to config LED %d", err);
        return 0;
    }    

    while(true)
    {
        k_msleep(1000);
        err = gpio_pin_set_dt(&led0, 1);
        if(err < 0) 
        {
            LOG_ERR("Failed to set LED %d", err);
            break;
        }

        k_msleep(1000);            
        err = gpio_pin_set_dt(&led0, 0);
        if(err < 0) 
        {
            LOG_ERR("Failed to set LED %d", err);
            break;
        }        
    }

    return 0;
}
```
