## CMakeLists.txt
```
cmake_minimum_required(VERSION 3.20.0)
find_package(Zephyr REQUIRED HINTS $ENV{ZEPHYR_BASE})

project(_udp)

target_sources(app PRIVATE src/main.c)
```

## prj.conf
```kconfig
CONFIG_FPU=y

# Stacks and heaps
CONFIG_MAIN_STACK_SIZE=4096
CONFIG_HEAP_MEM_POOL_SIZE=4096

# Log
CONFIG_LOG=y
CONFIG_LOG_DEFAULT_LEVEL=3
CONFIG_LOG_BUFFER_SIZE=2048
CONFIG_LOG_BACKEND_RTT=n
CONFIG_LOG_BACKEND_UART=y
CONFIG_LOG_BACKEND_UART_BUFFER_SIZE=2048

# FLASH # NVS
CONFIG_FLASH=y
CONFIG_FLASH_MAP=y
CONFIG_FLASH_PAGE_LAYOUT=y
CONFIG_MPU_ALLOW_FLASH_WRITE=y
CONFIG_NVS=y

# Network
CONFIG_NETWORKING=y
CONFIG_NET_NATIVE=n 
CONFIG_NET_SOCKETS=y
CONFIG_NET_SOCKETS_OFFLOAD=y 
CONFIG_NET_IPV4=y

# Modem library
CONFIG_NRF_MODEM_LIB=y
CONFIG_NRF_MODEM_LIB_TRACE=n
CONFIG_ZVFS_OPEN_MAX=8

# LTE link control
CONFIG_LTE_LINK_CONTROL=y
```

## src/main.c
```c
#include <zephyr/kernel.h>
#include <zephyr/logging/log.h>
#include <nrf_modem.h> 
#include <nrf_modem_at.h> 
#include <modem/nrf_modem_lib.h>
#include <modem/lte_lc.h>
#include <zephyr/net/socket.h>
#include <zephyr/net/net_ip.h>

LOG_MODULE_REGISTER(main_udp, CONFIG_LOG_DEFAULT_LEVEL);

static K_SEM_DEFINE(udpsem_start, 0, 1);

static int socknum;
static uint8_t rxpktbuf[64];
static bool isconnected = false;

int main(void)
{
    nrf_modem_lib_init();

    LOG_INF("=====UDP EXAMPLE=====");
    
    struct sockaddr_in sa;
    int ret;

    lte_lc_connect();

    socknum = zsock_socket(AF_INET, SOCK_DGRAM, IPPROTO_UDP);

    sa.sin_family = AF_INET;
    sa.sin_port = htons(7777);
    zsock_inet_pton(AF_INET, "43.200.166.133", &sa.sin_addr); /* echo server IP address */
     
	ret = zsock_connect(socknum, (struct sockaddr *)&sa, sizeof(struct sockaddr_in));
	if(ret < 0) {
		LOG_ERR("connect failed:%d", ret);
	}
    LOG_INF("udp connected...");
    isconnected = true;

    k_sem_give(&udpsem_start);

    int txcnt = 5;
    while(txcnt--){
        uint8_t txbuf[] = "this is test for udp";
        LOG_INF("send.....%d", txcnt);
        ret = zsock_send(socknum, txbuf, sizeof(txbuf), 0);
        k_msleep(5000);
    }

    isconnected = false;

    LOG_INF("udp close...");
    LOG_INF("main close...");

    return 0;
}

static void udp_thread(void)
{
    int ret;
    struct zsock_pollfd fds[1]; 

    fds[0].fd = socknum;
    fds[0].events = ZSOCK_POLLIN;

    k_sem_take(&udpsem_start, K_FOREVER);
    LOG_INF("udp poll start...");

    while(isconnected) {
        ret = zsock_poll(fds, 1, 1000);
        if (ret < 0) {
            LOG_ERR("poll() failed: (%d)", -errno);
            ret = -EIO;
            continue;
	    }
        if (ret == 0) {
            continue;   /* poll() timeout */
        }
        if ((fds[0].revents & ZSOCK_POLLHUP) == ZSOCK_POLLHUP) {
            LOG_ERR("POLLHUP");
            break;
	    }
        if ((fds[0].revents & ZSOCK_POLLNVAL) == ZSOCK_POLLNVAL) {
            LOG_ERR("POLLNVAL");
            break;
        }
        if ((fds[0].revents & ZSOCK_POLLERR) == ZSOCK_POLLERR) {
            LOG_WRN("POLLERR");
            break;
        }
        if ((fds[0].revents & ZSOCK_POLLIN) == ZSOCK_POLLIN) {
            ret = zsock_recv(fds[0].fd, (void *)rxpktbuf, sizeof(rxpktbuf), 0);
            if (ret <= 0) {
                LOG_ERR("recv() failed: (%d)", -errno);
            }
            else if(ret >= 0) {
                LOG_INF("recv(%d): %.*s", ret, ret, rxpktbuf);
            }
        } 
    }

    zsock_close(socknum);
    lte_lc_power_off();
    LOG_INF("udp thread close...");
    return;
}

K_THREAD_DEFINE(udp_thread_id, 2048, udp_thread, NULL, NULL, NULL, 1, 0, 0);
```
