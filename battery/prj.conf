## CMakeLists.txt
```
cmake_minimum_required(VERSION 3.20.0)
find_package(Zephyr REQUIRED HINTS $ENV{ZEPHYR_BASE})

project(battery)

target_sources(app PRIVATE src/main.c)
```

## prj.conf
```kconfig
CONFIG_FPU=y

# Stacks and heaps
CONFIG_MAIN_STACK_SIZE=4096
CONFIG_HEAP_MEM_POOL_SIZE=4096

# Log
CONFIG_LOG=y
CONFIG_LOG_DEFAULT_LEVEL=3
CONFIG_LOG_BUFFER_SIZE=2048
CONFIG_LOG_BACKEND_RTT=n

# Modem library
CONFIG_NRF_MODEM_LIB=y
CONFIG_MODEM_INFO=y 
CONFIG_NRF_MODEM_LIB_TRACE=n
CONFIG_ZVFS_OPEN_MAX=8

# FLASH # NVS
CONFIG_FLASH=y
CONFIG_MPU_ALLOW_FLASH_WRITE=y
```

## src/main.c
```c
#include <zephyr/kernel.h>
#include <zephyr/devicetree.h>
#include <zephyr/logging/log.h>
#include <modem/modem_info.h>
#include <modem/nrf_modem_lib.h>

LOG_MODULE_REGISTER(main);

int main(void)
{
    nrf_modem_lib_init();
    
    LOG_INF("=====Battery Voltage Sample=====");
    
    modem_info_init();
    
    /* Get battery voltage */
    int voltage = 0;
    modem_info_get_batt_voltage(&voltage);
    LOG_INF("Battery Voltage: %d mV", voltage);

    return 0;
}
```
